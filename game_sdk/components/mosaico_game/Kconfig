## game_sdk/components/mosaico_game/Kconfig
```kconfig
menu "Mosaico Game Runtime"

config MOSAICO_GAME_DEFAULT_FPS
    int "Default target frame rate"
    range 1 120
    default 30

config MOSAICO_GAME_EVENT_QUEUE_LENGTH
    int "Device event queue length"
    range 8 128
    default 32

endmenu
```

## game_sdk/components/mosaico_game_2d/Kconfig
```kconfig
menu "Mosaico Game 2D"

config MOSAICO_GAME_MAX_TEXTURES
    int "Maximum simultaneously loaded atlases"
    range 1 32
    default 12

endmenu
```

## game_sdk/components/mosaico_game_audio/Kconfig
```kconfig
menu "Mosaico Game Audio"

config MOSAICO_GAME_AUDIO_CLIPS
    int "Maximum loaded audio clips"
    range 4 64
    default 20

config MOSAICO_GAME_AUDIO_VOICES
    int "Simultaneous sound-effect voices"
    range 1 16
    default 8

endmenu
```

## game_sdk/components/mosaico_raylib_port/Kconfig
```kconfig
menu "Mosaico Game Display"

config MOSAICO_GAME_FRAMEBUFFER_COUNT
    int "PSRAM framebuffer count"
    range 2 4
    default 4
    help
        Each 480x480 RGB565 framebuffer uses 450 KiB of PSRAM. More buffers
        tolerate display latency but reduce memory available to the game.

endmenu
```

## projects/gsp_sub_board/main/Kconfig.projbuild
```kconfig
menu "Sub-board demos"
config SUB_BOARD_DIN_LEFT_GPIO
    int "Left matrix LED DIN GPIO"
    default 48
    range 0 55
config SUB_BOARD_DIN_RIGHT_GPIO
    int "Right matrix LED DIN GPIO"
    default 47
    range 0 55
endmenu
```
